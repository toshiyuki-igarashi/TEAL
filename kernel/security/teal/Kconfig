## kernel/security/teal/Kconfig
```kconfig
config SECURITY_TEAL
	bool "TEAL Integrated LSM support"
	depends on SECURITY
	depends on RUST
	default n
	help
	  Enables the TEAL (Trust-Enhanced Adaptive Layer) LSM.
```
